## CMakeLists.txt
```
#
# CMakeLists.txt -- IAQ gateway (nRF52840 Dongle)
#
cmake_minimum_required(VERSION 3.20.0)

find_package(Zephyr REQUIRED HINTS $ENV{ZEPHYR_BASE})
project(iaq_gateway)

target_sources(app PRIVATE src/main.c)
```

## prj.conf
```kconfig
# prj.conf -- IAQ gateway (nRF52840 Dongle)

# ---- Bluetooth: observer / scanner only ----
CONFIG_BT=y
CONFIG_BT_OBSERVER=y
CONFIG_BT_CENTRAL=n
CONFIG_BT_PERIPHERAL=n
CONFIG_BT_DEVICE_NAME="IAQ-Gateway"

# ---- Native USB serial (CDC ACM) so the host gets a COM/tty port ----
CONFIG_USB_DEVICE_STACK=y
CONFIG_USB_DEVICE_PRODUCT="IAQ Gateway"
CONFIG_USB_CDC_ACM=y
CONFIG_SERIAL=y
CONFIG_UART_LINE_CTRL=y
CONFIG_UART_INTERRUPT_DRIVEN=y

# Route printk()/console to the CDC ACM port (see overlay chosen node)
CONFIG_CONSOLE=y
CONFIG_UART_CONSOLE=y

CONFIG_MAIN_STACK_SIZE=4096
```

## boards/nrf52840dongle_nrf52840.overlay
```dts
/*
 * nrf52840dongle_nrf52840.overlay -- IAQ gateway
 *
 * Defines a USB CDC ACM serial port and makes it the system console, so that
 * printk() in main.c streams JSON lines out of the dongle's native USB to the
 * host PC.
 */

&zephyr_udc0 {
	cdc_acm_uart0: cdc_acm_uart0 {
		compatible = "zephyr,cdc-acm-uart";
	};
};

/ {
	chosen {
		zephyr,console = &cdc_acm_uart0;
	};
};
```

## src/main.c
```c
/*
 * main.c -- Gateway (nRF52840 Dongle) for the IAQ monitor.
 *
 * Acts as a BLE Observer: passively scans advertising channels, finds packets
 * whose Manufacturer-Specific Data starts with our company ID (0xFFFF) and the
 * expected length, unpacks the fields and prints ONE JSON object per packet to
 * the host over the dongle's native USB serial port (CDC ACM).
 *
 * The host-side backend/parser.py reads these JSON lines.
 *
 * NOTE: the dongle enumerates its OWN USB serial port -- you do NOT need the
 * FTDI bridge for this path. (The FTDI/Waveshare option is documented in the
 * repo README as an alternative if you instead take UART pins out.)
 */
#include <zephyr/kernel.h>
#include <zephyr/bluetooth/bluetooth.h>
#include <zephyr/usb/usb_device.h>
#include <zephyr/drivers/uart.h>
#include <zephyr/sys/printk.h>
#include <string.h>

#include "payload.h"

struct parse_ctx {
	bool     found;
	uint8_t  data[IAQ_PAYLOAD_LEN];
};

static uint16_t get_le16(const uint8_t *p)
{
	return (uint16_t)(p[0] | (p[1] << 8));
}

/* Called once per AD structure inside an advertisement. */
static bool ad_cb(struct bt_data *data, void *user_data)
{
	struct parse_ctx *ctx = user_data;

	if (data->type != BT_DATA_MANUFACTURER_DATA) {
		return true; /* keep walking */
	}
	if (data->data_len != IAQ_PAYLOAD_LEN) {
		return true;
	}
	if (get_le16(data->data) != IAQ_COMPANY_ID) {
		return true;
	}
	memcpy(ctx->data, data->data, IAQ_PAYLOAD_LEN);
	ctx->found = true;
	return false; /* stop -- we have it */
}

static void scan_cb(const bt_addr_le_t *addr, int8_t rssi, uint8_t adv_type,
		    struct net_buf_simple *buf)
{
	struct parse_ctx ctx = { .found = false };
	bt_data_parse(buf, ad_cb, &ctx);
	if (!ctx.found) {
		return;
	}

	const uint8_t *d = ctx.data;

	/* Verify the air-link CRC before trusting the values. */
	if (iaq_crc8(&d[2], 15) != d[17]) {
		printk("{\"error\":\"crc\"}\n");
		return;
	}

	uint16_t co2  = get_le16(&d[2]);
	int16_t  tc   = (int16_t)get_le16(&d[4]);
	uint16_t rh   = get_le16(&d[6]);
	uint16_t pm   = get_le16(&d[8]);
	uint16_t tvoc = get_le16(&d[10]);
	uint16_t eco2 = get_le16(&d[12]);
	uint16_t lux  = get_le16(&d[14]);
	uint8_t  pkt  = d[16];

	printk("{\"co2\":%u,\"temp\":%d.%02d,\"rh\":%u.%02u,"
	       "\"pm25\":%u.%u,\"tvoc\":%u,\"eco2\":%u,\"lux\":%u,"
	       "\"rssi\":%d,\"pkt\":%u}\n",
	       co2, tc / 100, (tc % 100 + 100) % 100,
	       rh / 100, rh % 100, pm / 10, pm % 10,
	       tvoc, eco2, lux, rssi, pkt);
}

int main(void)
{
	int rc;

	/* Bring up native USB so the host sees a serial port. */
	rc = usb_enable(NULL);
	if (rc) {
		/* Continue anyway: RTT logging still works for debugging. */
	}
	k_msleep(1500); /* give the host time to enumerate the port */

	rc = bt_enable(NULL);
	if (rc) {
		printk("bt_enable failed (%d)\n", rc);
		return 0;
	}

	struct bt_le_scan_param scan = {
		.type     = BT_LE_SCAN_TYPE_PASSIVE,
		.options  = BT_LE_SCAN_OPT_NONE,
		.interval = BT_GAP_SCAN_FAST_INTERVAL,
		.window   = BT_GAP_SCAN_FAST_WINDOW,
	};

	rc = bt_le_scan_start(&scan, scan_cb);
	if (rc) {
		printk("scan start failed (%d)\n", rc);
		return 0;
	}

	printk("{\"status\":\"gateway scanning\"}\n");
	return 0;
}
```

## src/payload.h
```c
/*
 * payload.h -- BLE manufacturer-data payload layout.
 * SHARED between edge_node and gateway: keep both copies identical.
 *
 * All multi-byte fields are LITTLE-ENDIAN. The first two bytes are the BLE
 * "company identifier" (0xFFFF = reserved/for-testing). The gateway uses this
 * ID to recognise our beacons.
 *
 * Offset  Size  Field            Units / encoding
 * ------  ----  ---------------  --------------------------------
 *   0      2    company_id       0xFFFF (LE)
 *   2      2    co2_ppm          u16 ppm                 (SCD41)
 *   4      2    temp_centi       s16, degC * 100         (MCP9808)
 *   6      2    rh_centi         u16, %RH * 100          (SCD41)
 *   8      2    pm25_deci        u16, ug/m3 * 10         (SPS30)
 *  10      2    tvoc_ppb         u16 ppb                 (CCS811)
 *  12      2    eco2_ppm         u16 ppm                 (CCS811)
 *  14      2    lux              u16                     (LDR)
 *  16      1    seq              u8 rolling counter
 *  17      1    crc8             CRC-8 over offsets 2..16
 * ------  ----
 * total   18 bytes
 */
#ifndef PAYLOAD_H
#define PAYLOAD_H

#include <stdint.h>

#define IAQ_COMPANY_ID 0xFFFF
#define IAQ_PAYLOAD_LEN 18

/* CRC-8, poly 0x07, init 0x00 -- simple integrity check for the air link. */
static inline uint8_t iaq_crc8(const uint8_t *d, uint32_t n)
{
	uint8_t crc = 0x00;
	for (uint32_t i = 0; i < n; i++) {
		crc ^= d[i];
		for (int b = 0; b < 8; b++) {
			crc = (crc & 0x80) ? (uint8_t)((crc << 1) ^ 0x07)
					   : (uint8_t)(crc << 1);
		}
	}
	return crc;
}

#endif /* PAYLOAD_H */
```
